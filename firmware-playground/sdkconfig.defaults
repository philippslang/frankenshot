## firmware-s3/sdkconfig.defaults
```kconfig
CONFIG_BT_ENABLED=y
CONFIG_BT_NIMBLE_ENABLED=y
CONFIG_BT_NIMBLE_50_FEATURE_SUPPORT=n

CONFIG_BLINK_LED_GPIO=y
CONFIG_BLINK_GPIO=38
CONFIG_ESP_TASK_WDT_TIMEOUT_S=45
```
